#include "configvals.h"
ENTRY(_start)
SECTIONS {
	. = CONFIG_LINK_ADDR_PREMMU;
	code_start = .;
	.startup . : {
		kernel/startup.o(.text)
	}
	/*.entry . : {
		kernel/entry.o(*)
	}*/
	ASSERT(. < code_start + 0x1000, "more than one page of memory for startup + ISR")
	nopreempt_begin = .;
	.nopreempt . : {
		*(.nopreempt)
	}
	nopreempt_end = .;
	.text . : {
		*(.text)
	}
	code_end = .;

	/* data on separate page to allow enforcing execute never */
	. = ALIGN(0x1000);
	data_start = .;
	.rodata . : {
		*(.rodata)
	}
	.data . : {
		*(.data)
		*(.data.rel)
		*(.data.rel.local)
	}
	bss_start = .;
	.bss . : {
		*(.bss)
	}
	data_end = .;

	/* Kernel mode stack */
	. = ALIGN(0x1000);
	stack_start = .;
	. = . + 0x1000; /* 4kB stack memory */
	stack_end = .;

	/* Unused memory here */
	. = ALIGN(0x4000);
	unused_start = .;
	dynamic_start = .;
}
